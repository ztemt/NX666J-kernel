## kernel/msm-5.4/drivers/vendor/soc/qcom/Kconfig
```kconfig
config VENDOR_SOC_QCOM_SRC
	bool "drivers/vendor/soc/qcom drivers compile control"
	default n
	help
		This enables drivers/vendor/soc/qcom drivers to be compiled.

source "drivers/vendor/soc/qcom/imem_info/Kconfig"
source "drivers/vendor/soc/qcom/nubia_hw_version/Kconfig"
```
